## Kconfig
```kconfig
menu "ESP32 Board Manager"

    config ESP32BM_WEB_Compressed_index
        bool "Use index.html.gz"
        default y
        help
            This enables the usage of index.html.gz file. If this is not set, index.html will be used.

    config ESP32BM_WEB_USE_favicon
        bool "Use favicon.ico"
        default y
        help
            This enables the usage of favicon.ico file.

endmenu
```

## example/sdkconfig.defaults
```kconfig
#
# For a module with 4MB flash size
#
CONFIG_ESPTOOLPY_FLASHSIZE_4MB=y
CONFIG_ESPTOOLPY_FLASHSIZE_DETECT=y

#
# Custom partitions
#
CONFIG_PARTITION_TABLE_SINGLE_APP=n
CONFIG_PARTITION_TABLE_TWO_OTA=n
CONFIG_PARTITION_TABLE_CUSTOM=y
CONFIG_PARTITION_TABLE_CUSTOM_FILENAME="partitions.csv"
CONFIG_PARTITION_TABLE_FILENAME="partitions.csv"



#
# NVS and PHY and WiFi
#
CONFIG_ESP32_PHY_CALIBRATION_AND_DATA_STORAGE=n
CONFIG_ESP32_PHY_INIT_DATA_IN_PARTITION=n
CONFIG_ESP32_WIFI_NVS_ENABLED=n

#
# Network
#
CONFIG_ESP_NETIF_TCPIP_ADAPTER_COMPATIBLE_LAYER=n

#
# Stack checks
#
CONFIG_COMPILER_STACK_CHECK_MODE_NORM=y
CONFIG_COMPILER_STACK_CHECK=y
```
